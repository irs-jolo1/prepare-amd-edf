/include/ "system-conf.dtsi"
/* #include <dt-bindings/gpio/gpio.h> */


// Parameters with # cause a syntax clash in the C preprocessor, therefore use own macros
#define DT_ADDRESS_CELLS #address-cells = <1>;
#define DT_SIZE_CELLS #size-cells = <0>;
#define DT_TRG_SRC_CELLS #trigger-source-cells = <1>;
#define DT_GPIO_CELLS #gpio-cells = <2>;

// Define Template for an SPI Engine node
// NOT ADDED: sync-in-gpios, reset-gpios
#define SPI_ENGINE_INSTANCE(ADCNUM, AXIADDR, SPI_IRQ, ADC_IRQ)          \
spi_engine_inst_##ADCNUM: axi_spi_engine@AXIADDR {                      \
  clock-names = "s_axi_aclk", "spi_clk";                                \
  clocks = <&zynqmp_clk 71>, <&misc_clk_0>;                             \
  compatible = "adi,axi-spi-engine-1.00.a", "xlnx,axi-spi-engine-1.0";  \
  interrupt-names = "irq";                                              \
  reg = <0x0 0x##AXIADDR 0x0 0x10000>;                                  \
  dma-names = "offload0-rx";                                            \
  trigger-sources = <&adc##ADCNUM 2>;                                   \
  DT_ADDRESS_CELLS                                                      \
  DT_SIZE_CELLS                                                         \
  adc##ADCNUM: adaq7768_##ADCNUM@0 {                                    \
    compatible = "adi,adaq7768-1";                                      \
    reg = <0>;                                                          \
    spi-max-frequency = <20000000>;                                     \
    spi-cpol;                                                           \
    spi-cpha;                                                           \
    clock-names = "mclk";                                               \
    gpio-controller;                                                    \
    DT_GPIO_CELLS                                                       \
    DT_TRG_SRC_CELLS                                                    \
  };                                                                    \
};

&amba_pl {
  SPI_ENGINE_INSTANCE(1, 80200000, 0, 85)
};
