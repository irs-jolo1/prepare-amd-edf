## workspace/build-small/conf/bblayers.conf
```bitbake
# POKY_BBLAYERS_CONF_VERSION is increased each time build/conf/bblayers.conf
# changes incompatibly
POKY_BBLAYERS_CONF_VERSION = "2"

BBPATH = "${TOPDIR}"
BBFILES ?= ""

BBLAYERS ?= " \
  /workspace/sources/poky/meta \
  /workspace/sources/poky/meta-poky \
  /workspace/sources/poky/../meta-openembedded/meta-oe \
  /workspace/sources/poky/../meta-openembedded/meta-python \
  /workspace/sources/poky/../meta-openembedded/meta-filesystems \
  /workspace/sources/poky/../meta-openembedded/meta-networking \
  /workspace/sources/poky/../meta-openembedded/meta-multimedia \
  /workspace/sources/poky/../meta-openembedded/meta-webserver \
  /workspace/sources/poky/../meta-virtualization \
  /workspace/sources/poky/../meta-security \
  /workspace/sources/poky/../meta-security/meta-tpm \
  /workspace/sources/poky/../meta-xilinx/meta-xilinx-core \
  /workspace/sources/poky/../meta-xilinx/meta-xilinx-standalone \
  /workspace/sources/poky/../meta-xilinx/meta-xilinx-standalone-sdt \
  /workspace/sources/poky/../meta-xilinx/meta-xilinx-multimedia \
  /workspace/sources/poky/../meta-xilinx/meta-xilinx-demos \
  /workspace/sources/poky/../meta-xilinx/meta-xilinx-virtualization \
  /workspace/sources/poky/../meta-xilinx/meta-xilinx-mali400 \
  /workspace/sources/poky/../meta-xilinx/meta-xilinx-gpu-malig78ae \
  /workspace/sources/poky/../meta-xilinx/meta-microblaze \
  /workspace/sources/poky/../meta-xilinx/meta-amd-zephyr \
  /workspace/sources/poky/../meta-xilinx-tsn \
  /workspace/sources/poky/../meta-openamp \
  /workspace/sources/poky/../meta-amd-edf \
  /workspace/sources/poky/../meta-amd-edf/meta-amd-edf-bsp \
  /workspace/sources/poky/../meta-kria \
  /workspace/sources/poky/../meta-amd-adaptive-socs/meta-amd-adaptive-socs-core \
  /workspace/sources/poky/../meta-amd-adaptive-socs/meta-amd-adaptive-socs-bsp \
  /workspace/sources/poky/../meta-xilinx/meta-xilinx-imgrcvry \
  /workspace/sources/poky/../meta-arm/meta-arm \
  /workspace/sources/poky/../meta-arm/meta-arm-toolchain \
  /workspace/sources/poky/../meta-jupyter \
  /workspace/sources/poky/../meta-ros/meta-ros-common \
  /workspace/sources/poky/../meta-ros/meta-ros2 \
  /workspace/sources/poky/../meta-ros/meta-ros2-jazzy \
  /workspace/sources/poky/../meta-qt5 \
  /workspace/sources/poky/../meta-vitis \
  /workspace/sources/poky/../meta-zephyr/meta-zephyr-core \
  /workspace/sources/poky/../meta-zephyr/meta-zephyr-bsp \
  /workspace/sources/poky/../meta-embedded-plus \
  /workspace/build-small/meta-myboard \
  "
```

## workspace/build-small/conf/machine/adaq7768.conf
```bitbake
#@TYPE: Machine
#@NAME: adaq7768
#@DESCRIPTION: Machine configuration for the adaq7768 boards.


BBMULTICONFIG += "adaq7768-cortexa53-fsbl adaq7768-microblaze-pmu"

#### Preamble
MACHINEOVERRIDES =. "${@['', 'adaq7768:']['adaq7768' !='${MACHINE}']}"
#### Regular settings follow
TUNEFILE[microblaze-pmu] = "conf/machine/include/adaq7768/microblaze.inc"

# First Stage Boot Loader
FSBL_DEPENDS = ""
FSBL_MCDEPENDS = "mc::adaq7768-cortexa53-fsbl:fsbl-firmware:do_deploy"
FSBL_DEPLOY_DIR = "${TMPDIR}-adaq7768-cortexa53-fsbl/deploy/images/${MACHINE}"

# PMU Firmware
PMU_DEPENDS = ""
PMU_MCDEPENDS = "mc::adaq7768-microblaze-pmu:pmu-firmware:do_deploy"
PMU_FIRMWARE_DEPLOY_DIR = "${TMPDIR}-adaq7768-microblaze-pmu/deploy/images/${MACHINE}"

# Set the default (linux) domain device tree
CONFIG_DTFILE_DIR := "${@bb.utils.which(d.getVar('BBPATH'), 'conf/dts/adaq7768')}"
CONFIG_DTFILE ?= "${CONFIG_DTFILE_DIR}/cortexa53-linux.dts"
CONFIG_DTFILE[vardepsexclude] += "CONFIG_DTFILE_DIR"

DTB_FILE_PATH ?= "${RECIPE_SYSROOT}/boot/devicetree/${@os.path.basename(d.getVar('CONFIG_DTFILE').replace('.dts', '.dtb'))}"

# Serial Console Settings
SERIAL_CONSOLES ?= "115200;ttyPS0"

# Yocto arm-trusted-firmware(TF-A) variables
TFA_CONSOLE ?= "cadence"
TFA_BL33_LOAD ?= "0x8000000"

# Yocto u-boot-xlnx variables

# Set DDR Base address for u-boot-xlnx-scr variables
DDR_BASEADDR ?= "0x0"
SKIP_APPEND_BASEADDR ?= "0"

# Yocto KERNEL Variables
UBOOT_ENTRYPOINT ?= "0x200000"
UBOOT_LOADADDRESS ?= "0x200000"

# Yocto MACHINE_FEATURES Variable
MACHINE_FEATURES += "mali400 efi"

# Required generic machine inclusion
require conf/machine/zynqmp-generic.conf

# This is an 'SDT' based BSP
XILINX_WITH_ESW = "sdt"

# Original SDT artifacts URL
SDT_URI = "file:///workspace/sdt"
SDT_URI[S] = "${WORKDIR}/workspace/sdt/sdt"

# Set the system device trees
SYSTEM_DTFILE_DEPENDS = "sdt-artifacts"
SYSTEM_DTFILE_DIR = "${RECIPE_SYSROOT}${datadir}/sdt/${MACHINE}"
SYSTEM_DTFILE = "${SYSTEM_DTFILE_DIR}/system-top.dts"

# Load the dynamic machine features
include conf/machine/include/adaq7768/${BB_CURRENT_MC}-features.conf
LIBXIL_CONFIG = "conf/machine/include/adaq7768/${BB_CURRENT_MC}-libxil.conf"

# zynqmp bitstream path 
BITSTREAM_PATH_DEPENDS = "sdt-artifacts"
BITSTREAM_PATH_DIR = "${RECIPE_SYSROOT}${datadir}/sdt/${MACHINE}"
BITSTREAM_PATH = "${BITSTREAM_PATH_DIR}/adaq7768_eval.bit"

# Primary Bootmode value
DEFAULT_HW_BOOT_MODE = "3"

# Update bootbin to use proper device tree
BIF_PARTITION_IMAGE[device-tree] = "${DTB_FILE_PATH}"

# Remap boot files to ensure the right device tree is listed first
IMAGE_BOOT_FILES =+ "devicetree/${@os.path.basename(d.getVar('CONFIG_DTFILE').replace('.dts', '.dtb'))}"

#### No additional settings should be after the Postamble
#### Postamble
PACKAGE_EXTRA_ARCHS:append = "${@['', ' adaq7768']['adaq7768' != '${MACHINE}']}"
```

## workspace/build-small/conf/machine/include/adaq7768/adaq7768-cortexa53-fsbl-features.conf
```bitbake
MACHINE_FEATURES = "axipmon clockps common coresightps-dcc csudma ddrcpsu emacps gpio gpiops iicps intc ipipsu qspipsu resetps rtcpsu scugic sdps sysmonpsu ttcps uartps usbpsu wdtps zdma"
```

## workspace/build-small/conf/machine/include/adaq7768/adaq7768-microblaze-pmu-features.conf
```bitbake
MACHINE_FEATURES = "axipmon clockps common csudma ddrcpsu emacps gpiops iicps intc ipipsu qspipsu resetps rtcpsu sdps sysmonpsu ttcps uartps usbpsu wdtps zdma"
```

## workspace/build-small/meta-myboard/conf/distro/irs-dev-distro.conf
```bitbake
DISTRO = "irs-dev-distro"
DISTRO_NAME = "IRS Custom Development Distro"
DISTRO_VERSION = "v0.1.0"

require conf/distro/irs-distro.conf

IMAGE_INSTALL:append = "\
    dtc \
    htop \
    opkg \
    libiio-tests \
"
```

## workspace/build-small/meta-myboard/recipes-kernel/fitimage/files/fitImage.its
```
/dts-v1/;

/ {
    description = "Combined kernel + initramfs + FPGA bitstream";
    #address-cells = <1>;

    images {
        kernel-1 {
            description = "Linux kernel";
            data = /incbin/("./Image");
            type = "kernel";
            arch = "arm64";
            os = "linux";
            compression = "none";
            load = <0x80000>;
            entry = <0x80000>;
            hash-1 { algo = "sha256"; };
        };

        fdt-1 {
            description = "Device Tree";
            data = /incbin/("./system.dtb");
            type = "flat_dt";
            arch = "arm64";
            compression = "none";
            hash-1 { algo = "sha256"; };
        };

        ramdisk-1 {
            description = "initramfs";
            data = /incbin/("./rootfs.cpio");
            type = "ramdisk";
            arch = "arm64";
            os = "linux";
            compression = "none";
            hash-1 { algo = "sha256"; };
        };

        fpga-1 {
            description = "PL bitstream";
            data = /incbin/("./system.bit.bin");
            type = "fpga";
            arch = "arm64";
            compression = "none";
            hash-1 { algo = "sha256"; };
        };
    };

    configurations {
        default = "conf-1";
        conf-1 {
            description = "kernel + fdt + ramdisk + fpga";
            kernel = "kernel-1";
            fdt = "fdt-1";
            ramdisk = "ramdisk-1";
            fpga = "fpga-1";
        };
    };
};
```
